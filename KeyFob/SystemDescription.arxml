AUTOSAR XML (schema 00050)
package /ARRoot
  elements:
    ecu-instance=can-communication-connector=/ARRoot//
    can-cluster=can-physical-channel=comm-connectors=/ARRoot//
